## conf/layer.conf
```bitbake
# We have a conf and classes directory, add to BBPATH
BBPATH .= ":${LAYERDIR}"

# We have recipes-* directories, add to BBFILES
BBFILES += "${LAYERDIR}/recipes-*/*/*.bb \
 ${LAYERDIR}/recipes-*/*/*.bbappend"

BBFILE_COLLECTIONS += "ctrace-s4"
BBFILE_PATTERN_ctrace-s4 = "^${LAYERDIR}/"
BBFILE_PRIORITY_ctrace-s4 = "10"

#CORE_IMAGE_EXTRA_INSTALL += "bluetooth"
CORE_IMAGE_EXTRA_INSTALL += "vfb-vnc"
CORE_IMAGE_EXTRA_INSTALL += "digital-inputs"
CORE_IMAGE_EXTRA_INSTALL += "ignition-status"
CORE_IMAGE_EXTRA_INSTALL += "wlan"
CORE_IMAGE_EXTRA_INSTALL += "can"
CORE_IMAGE_EXTRA_INSTALL += "led"
CORE_IMAGE_EXTRA_INSTALL += "autostart"
CORE_IMAGE_EXTRA_INSTALL += "start-applications"
CORE_IMAGE_EXTRA_INSTALL += "gps"
```
